
OUTPUT_ARCH( "riscv" )

ENTRY(main)

/*----------------------------------------------------------------------*/
/* Sections                                                             */
/*----------------------------------------------------------------------*/

MEMORY {

       ram(wxa!ri): ORIGIN = 0x80000000, LENGTH = 0x4000

}

SECTIONS {

	 .text :
	 {
	 	 *(.text*)
	 }
	 > ram
	   . = ALIGN(4);

}
